## main/Kconfig.projbuild
```kconfig
menu "Example Configuration"

    config INNER_BARRIER_PIN
        int "Inner barrier GPIO pin"
        range 0 34
        default 5
        help
            GPIO number (IOxx) of the inner barrier pin.

            Some GPIOs are used for other purposes (flash connections, etc.) and cannot be used as input.

            GPIOs 35-39 are input-only so cannot be used as outputs.

    config OUTER_BARRIER_PIN
        int "Outer barrier GPIO pin"
        range 0 34
        default 26
        help
            GPIO number (IOxx) of the outer barrier pin.

            Some GPIOs are used for other purposes (flash connections, etc.) and cannot be used as input.

            GPIOs 35-39 are input-only so cannot be used as outputs.

endmenu
```
